## lib/bloom/Kconfig
```kconfig
# Copyright (c) 2026 Vilhelm Engström
#
# SPDX-License-Identifier: Apache-2.0

config BLOOM_FILTER
	bool "Enable generic bloom filter implementation"
	select SYS_HASH_FUNC_MURMUR128
	help
	  A bloom filter is a space-efficient probabilistic data structure
	  used to test for set membership. Lookups may yield false positives
	  but never false negatives.

if BLOOM_FILTER

config BLOOM_FILTER_SIZE
	bool "Track number of entries in bloom filters"
	default y
	help
	  Provides access to the bloom_filter_size function.

endif
```

## lib/hash/Kconfig
```kconfig
# Copyright (c) 2026 Vilhelm Engström
#
# SPDX-License-Identifier: Apache-2.0

config SYS_HASH_FUNC_MURMUR128
	bool "32 bit (x86) murmur3 hash with 128 bit digest"
	help
	  Enable the x86 version of the 128-bit digest murmur3 hash.
```
